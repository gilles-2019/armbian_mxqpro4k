## u-boot/u-boot-sunxi/defconfig/mxqpro4k_defconfig
```kconfig
CONFIG_ARM=y
CONFIG_ARCH_SUNXI=y
CONFIG_DEFAULT_DEVICE_TREE="sun8i-h3-mxqpro4k"
CONFIG_SPL=y
CONFIG_MACH_SUN8I_H3=y
# 
# ddram
#
CONFIG_SUNXI_DRAM_LPDDR3_STOCK=y
CONFIG_DRAM_CLK=408
CONFIG_DRAM_ZQ=3750393
#
CONFIG_MMC_SUNXI_SLOT_EXTRA=2
#
# CONFIG_SYS_MALLOC_CLEAR_ON_INIT is not set
CONFIG_SUN8I_EMAC=y
CONFIG_USB_EHCI_HCD=y
#
# autoboot delay
#
CONFIG_BOOTDELAY=10
CONFIG_AUTOBOOT_KEYED=y
CONFIG_AUTOBOOT_FLUSH_STDIN=y
CONFIG_AUTOBOOT_STOP_STR="s"
CONFIG_AUTOBOOT_KEYED_CTRLC=y
```
